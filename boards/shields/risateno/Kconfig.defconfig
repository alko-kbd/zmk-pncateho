## boards/shields/risateno/Kconfig.defconfig
```kconfig
# Copyright (c) 2020 The ZMK Contributors
# SPDX-License-Identifier: MIT

config ZMK_KEYBOARD_NAME
    default "RISATENO"

config ZMK_SPLIT_ROLE_CENTRAL
    default y

config ZMK_SPLIT
    default n
```

## config/boards/shields/RISATENO/Kconfig.defconfig
```kconfig
# Copyright (c) 2020 The ZMK Contributors
# SPDX-License-Identifier: MIT

config ZMK_KEYBOARD_NAME
    default "RiSATENOO"

config ZMK_SPLIT
    default n
```
